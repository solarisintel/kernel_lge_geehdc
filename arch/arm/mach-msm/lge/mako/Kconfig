## arch/arm/mach-msm/lge/mako/Kconfig
```kconfig
config BOARD_HEADER_FILE
	string "LGE board specific header file name"
	default ""

config MACH_APQ8064_MAKO
	depends on ARCH_APQ8064
	select MACH_LGE
	bool "MSM8064 MAKO"
	help
	  Support for the LGE MAKO device.

config MACH_APQ8064_J1D
    depends on ARCH_APQ8064
    select MACH_LGE
    bool "APQ8064 J1D"
    help
      Support for the LGE Fusion3 J1D(Docomo) device.
```

## drivers/video/msm/Kconfig.rej
```kconfig
--- drivers/video/msm/Kconfig	2022-12-09 13:34:15.219037900 +0900
+++ drivers/video/msm/Kconfig	2022-12-08 16:42:14.268562300 +0900
@@ -679,6 +689,10 @@
 	bool "MIPI LG Display WXGA PT Panel"
 	select FB_MSM_MIPI_LGIT_VIDEO_WXGA_PT
 
+config FB_MSM_MIPI_HITACHI_VIDEO_HD_PT_PANEL
+       bool "MIPI HITACHI Display HD PT Panel"
+       select FB_MSM_MIPI_HITACHI_VIDEO_HD_PT
+
 config FB_MSM_MIPI_TOSHIBA_VIDEO_WVGA_PT_PANEL
 	bool "MIPI Toshiba WVGA PT Panel"
 	select FB_MSM_MIPI_TOSHIBA_VIDEO_WVGA_PT
```
